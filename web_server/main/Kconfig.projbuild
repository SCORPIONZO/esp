## web_server/main/Kconfig.projbuild
```kconfig
# Kconfig file for the main component

config BLINK_GPIO
    int "GPIO number for blinking LED"
    default 2
    help
      This specifies which GPIO to use for controlling the LED.
```

## web_server/sdkconfig.defaults
```kconfig
# Default configuration for web server project

# Enable HTTP server component
CONFIG_HTTPD_ENABLED=y
CONFIG_HTTPD_MAX_REQ_HANDLERS=8
CONFIG_HTTPD_MAX_URIHandlers=8
CONFIG_HTTPD_URI_MATCH_WILDCARD=y

# WiFi configuration
CONFIG_ESP_WIFI_ENABLED=y
CONFIG_ESP_WIFI_SOFTAP_MODE=y
CONFIG_ESP_WIFI_AUTH_WPA2_PSK=y
```
